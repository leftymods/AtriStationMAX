## board/amlogic/atr_01_v1/Kconfig
```kconfig
if TARGET_MESON_G12A

config SYS_CPU
	string
	default "armv8"

config SYS_BOARD
	string
	default "atr_01_v1"

config SYS_VENDOR
	string
	default "leftymods"

config SYS_SOC
	string
	default "sm1"

config SYS_CONFIG_NAME
	default "atr_01_v1"

endif
```

## board/amlogic/defconfigs/atr_01_v1_defconfig
```kconfig
CONFIG_ARM=y
CONFIG_TARGET_MESON_G12A=y
CONFIG_SM1_ATR_01_V1=y
CONFIG_DM=y
CONFIG_DM_GPIO=y
CONFIG_AML_GPIO=y
CONFIG_DM_I2C=y
CONFIG_SYS_I2C_MESON=y
CONFIG_AML_PARTITION=y
CONFIG_AML_SD_EMMC=y
CONFIG_MMC=y
CONFIG_DM_MMC=y
CONFIG_CMD_MMC=y
CONFIG_ENV_IS_IN_MMC=y
CONFIG_SYS_MMC_ENV_DEV=1
CONFIG_FIP_IMG_SUPPORT=y
CONFIG_FS_EXT4=y
CONFIG_CMD_EXT4=y
CONFIG_AML_SECURE_UBOOT=y
CONFIG_UNIFY_KEY_MANAGE=y
```
